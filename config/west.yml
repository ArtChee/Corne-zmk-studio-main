## config/west.yml
```yaml
manifest:
  remotes:
  #- name: krikun98
  #    url-base: https://github.com/krikun98
    - name: zmkfirmware
      url-base: https://github.com/zmkfirmware
  projects:
    - name: zmk
      remote: zmkfirmware
      revision: v0.3
      import: app/west.yml
  self:
    path: config
```
